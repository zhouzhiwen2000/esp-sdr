## legacy/transceiver/main/Kconfig.projbuild
```kconfig
menu "ESP-SDR transport"

    config ESP_SDR_TRANSPORT_ETHERNET
        bool "Ethernet (HTTP control and UDP IQ)"
        default y
        help
            Use the onboard YT8531 RGMII Ethernet PHY. The board obtains
            its IPv4 address through DHCP and advertises esp-sdr.local.

    config ESP_SDR_TRANSPORT_USB
        bool "USB (vendor control and bulk IQ)"
        default y if IDF_TARGET_ESP32S31
        help
            Use the native high-speed USB-OTG device port with the
            vendor-specific ESP-SDR control and IQ protocol. Ethernet and USB
            may be enabled together; the most recently started stream owns the
            shared half-duplex IQ engine.

    config ESP_SDR_S3_UART_ENABLED
        bool "S3 UART0 I/Q transport"
        depends on IDF_TARGET_ESP32S3
        default y
        help
            Enable the optional USB-to-UART bridge interface. Disable it to
            leave the UART GPIOs unused by the application. Native USB remains
            available in either case.

    config ESP_SDR_S3_UART_BAUD
        int "S3 UART0 I/Q baud rate"
        depends on IDF_TARGET_ESP32S3
        range 115200 3000000
        default 921600
        help
            The burst I/Q protocol is also available on UART0, 8N1, without
            hardware flow control. The browser baud rate must match this value.

    config ESP_SDR_S3_UART_TX_PIN
        int "S3 UART0 TX GPIO"
        depends on IDF_TARGET_ESP32S3
        range 0 48
        default 43

    config ESP_SDR_S3_UART_RX_PIN
        int "S3 UART0 RX GPIO"
        depends on IDF_TARGET_ESP32S3
        range 0 48
        default 44

endmenu

menu "ESP-SDR transmitter"

    config ESP_SDR_S31_TX_PIE_REFILL
        bool "PIE-accelerated S31 TX replay refill"
        depends on IDF_TARGET_ESP32S31
        default y
        help
            Use the ESP32-S31 128-bit PIE load/store engine for aligned
            PSRAM-to-TCM copies, including the first finite replay segment
            and the fallback path when direct GDMA is unavailable. A
            PIE-only build shortens replay segments by three samples so every
            source offset remains 16-byte aligned.

    config ESP_SDR_S31_TX_DIRECT_DMA_REFILL
        bool "Direct AXI-GDMA S31 TX replay refill"
        depends on IDF_TARGET_ESP32S31
        default y
        help
            Copy finite replay segments directly from the PSRAM upload into
            the CPU-owned TCM aperture with AXI GDMA. The replay gate remains
            closed until the blocking DMA completes. This substantially
            reduces, but cannot eliminate, inter-segment RF gaps.

    config ESP_SDR_S31_TX_PIPELINED_REFILL
        bool "DMA-prefetch segmented S31 TX replay"
        depends on IDF_TARGET_ESP32S31
        default n
        help
            Prefetch the next finite-burst segment from PSRAM into internal
            SRAM with AXI GDMA while the modem transmits the current segment.
            This reduces the unavoidable CPU-owned aperture refill gap.

endmenu

menu "ESP-SDR receiver"

    config ESP_SDR_S31_CONTINUOUS_REAL_IF
        bool "Lossless continuous S31 PARLIO receiver"
        depends on IDF_TARGET_ESP32S31
        default y
        help
            Capture the live modem diagnostic lanes with PARLIO without CPU
            access to the modem-owned TCM dump aperture. The normal combined
            Ethernet/USB image publishes native signed I/Q at 16 MS/s complex
            on either transport. A USB-only compatibility build retains the
            older 4 MS/s real-IF capture and 2 MS/s host conversion path.

endmenu
```

## legacy/transceiver/sdkconfig.defaults.esp32s31
```kconfig
CONFIG_IDF_TARGET="esp32s31"
CONFIG_ESPTOOLPY_FLASHSIZE_16MB=y
CONFIG_ESPTOOLPY_HEADER_FLASHSIZE_UPDATE=y
CONFIG_PARTITION_TABLE_CUSTOM=y
CONFIG_PARTITION_TABLE_CUSTOM_FILENAME="partitions.csv"
CONFIG_ESP_SDR_TRANSPORT_ETHERNET=y
CONFIG_ESP_SDR_TRANSPORT_USB=y
CONFIG_ESP_SDR_S31_TX_PIE_REFILL=y
CONFIG_ESP_SDR_S31_TX_DIRECT_DMA_REFILL=y
# CONFIG_ESP_SDR_S31_TX_PIPELINED_REFILL is not set
CONFIG_ESP_PHY_ENABLE_CERT_TEST=y
CONFIG_ESP_PHY_DEBUG=y
CONFIG_ESP_PHY_DISABLE_PLL_TRACK=y
CONFIG_ESP_CONSOLE_UART_CUSTOM=y
CONFIG_ESP_CONSOLE_UART_CUSTOM_NUM_0=y
CONFIG_ESP_CONSOLE_UART_BAUDRATE=115200
CONFIG_ESP_CONSOLE_SECONDARY_NONE=y
CONFIG_ESP_MAIN_TASK_STACK_SIZE=6144
CONFIG_FREERTOS_HZ=1000
CONFIG_ESP_TIMER_SUPPORTS_ISR_DISPATCH_METHOD=y
# Keep the scheduler API in internal IRAM; avoiding flash/PSRAM XIP stalls is
# required for native-USB TX throughput. Moving mDNS/HTTP tasks to PSRAM leaves
# internal heap for the full GMAC RX ring, whose stopped buffers are borrowed
# as the native-USB realtime DIRAM staging ring.
CONFIG_FREERTOS_IN_IRAM=y
CONFIG_SPIRAM=y
CONFIG_SPIRAM_MODE_OCT=y
CONFIG_SPIRAM_SPEED_250M=y
CONFIG_SPIRAM_USE_CAPS_ALLOC=y
CONFIG_SPIRAM_MEMTEST=y
CONFIG_SPIRAM_XIP_FROM_PSRAM=y
CONFIG_FREERTOS_TASK_CREATE_ALLOW_EXT_MEM=y
CONFIG_MDNS_TASK_CREATE_FROM_SPIRAM=y
CONFIG_MDNS_MEMORY_ALLOC_SPIRAM=y
CONFIG_ETH_USE_ESP32_EMAC=y
# CONFIG_ETH_USE_SPI_ETHERNET is not set
CONFIG_ETH_DMA_BUFFER_SIZE=1536
CONFIG_ETH_DMA_RX_BUFFER_NUM=15
# CONFIG_ETH_SOFT_FLOW_CONTROL is not set
CONFIG_ETH_DMA_TX_BUFFER_NUM=12
CONFIG_ETH_TRANSMIT_MUTEX=y
CONFIG_ETH_IRAM_OPTIMIZATION=y
CONFIG_LWIP_MAX_SOCKETS=12
CONFIG_LWIP_UDP_RECVMBOX_SIZE=32
CONFIG_LWIP_TCPIP_CORE_LOCKING=y
CONFIG_LWIP_TCPIP_TASK_PRIO=21
CONFIG_LWIP_TCPIP_TASK_AFFINITY_CPU0=y
# CONFIG_MDNS_ENABLE_CONSOLE_CLI is not set
CONFIG_COMPILER_OPTIMIZATION_PERF=y
# CONFIG_COMPILER_OPTIMIZATION_DEBUG is not set
# CONFIG_PM_SLEEP_FUNC_IN_IRAM is not set
# CONFIG_PM_SLP_IRAM_OPT is not set
# CONFIG_PM_POWER_DOWN_CPU_IN_LIGHT_SLEEP is not set
CONFIG_ESP_WIFI_STATIC_RX_BUFFER_NUM=2
CONFIG_ESP_WIFI_DYNAMIC_RX_BUFFER_NUM=2
CONFIG_ESP_WIFI_DYNAMIC_TX_BUFFER_NUM=4
# CONFIG_ESP_WIFI_AMPDU_TX_ENABLED is not set
# CONFIG_ESP_WIFI_AMPDU_RX_ENABLED is not set
# CONFIG_ESP_WIFI_NVS_ENABLED is not set
# CONFIG_ESP_WIFI_ENABLE_WPA3_SAE is not set
# CONFIG_ESP_WIFI_ENABLE_WPA3_OWE_STA is not set
# CONFIG_ESP_WIFI_ENABLE_WPA3_OWE_SOFTAP is not set
# CONFIG_ESP_WIFI_GMAC_SUPPORT is not set
# CONFIG_ESP_WIFI_ENTERPRISE_SUPPORT is not set
CONFIG_ESP_WIFI_RX_MGMT_BUF_NUM_DEF=2
CONFIG_ESP_WIFI_MGMT_SBUF_NUM=6
# CONFIG_ESP_WIFI_IRAM_OPT is not set
# CONFIG_ESP_WIFI_EXTRA_IRAM_OPT is not set
# CONFIG_ESP_WIFI_RX_IRAM_OPT is not set
# CONFIG_ESP_WIFI_SLP_IRAM_OPT is not set
CONFIG_WIFI_RMT_STATIC_RX_BUFFER_NUM=2
CONFIG_WIFI_RMT_DYNAMIC_RX_BUFFER_NUM=2
CONFIG_WIFI_RMT_DYNAMIC_TX_BUFFER_NUM=4
# CONFIG_WIFI_RMT_AMPDU_TX_ENABLED is not set
# CONFIG_WIFI_RMT_AMPDU_RX_ENABLED is not set
# CONFIG_WIFI_RMT_NVS_ENABLED is not set
# CONFIG_WIFI_RMT_ENABLE_WPA3_SAE is not set
# CONFIG_WIFI_RMT_ENABLE_WPA3_OWE_STA is not set
# CONFIG_WIFI_RMT_ENABLE_WPA3_OWE_SOFTAP is not set
# CONFIG_WIFI_RMT_GMAC_SUPPORT is not set
# CONFIG_WIFI_RMT_ENTERPRISE_SUPPORT is not set
CONFIG_WIFI_RMT_RX_MGMT_BUF_NUM_DEF=2
CONFIG_WIFI_RMT_MGMT_SBUF_NUM=6
# CONFIG_WIFI_RMT_IRAM_OPT is not set
# CONFIG_WIFI_RMT_EXTRA_IRAM_OPT is not set
# CONFIG_WIFI_RMT_RX_IRAM_OPT is not set
# CONFIG_WIFI_RMT_SLP_IRAM_OPT is not set
CONFIG_ULP_COPROC_ENABLED=y
CONFIG_ULP_COPROC_TYPE_LP_CORE=y
CONFIG_ULP_COPROC_RESERVE_MEM=4096
```

## main/Kconfig.projbuild
```kconfig
menu "ESP-SDR transport"

    config ESP_SDR_S31_DMA_COPY
        bool "Experimental S31 SRAM DMA staging"
        depends on ESP_SDR_S31_DIRECT_TX
        default n
        help
            Use a preallocated GDMA channel pair to move IQ from the PARLIO
            ring into stable SRAM buffers. CPU prepares packet headers.

    config ESP_SDR_S31_DIRECT_TX
        bool "Experimental S31 direct DMA Ethernet TX"
        depends on ESP_SDR_S31_ETHERNET
        default n
        help
            Borrow IQ buffers for MAC DMA and drain before reusing each buffer,
            avoiding the driver payload copy. Requires the pinned IDF driver.
            A transmitter that does not release buffers within 100 ms resets
            the board to prevent DMA from accessing freed or reused memory.

    config ESP_SDR_S31_ETHERNET
        bool "S31 Function CoreBoard-1 continuous Ethernet receiver"
        depends on IDF_TARGET_ESP32S31
        default n
        help
            Enable the board's YT8531 Gigabit Ethernet interface and PARLIO
            circular-DMA receiver. Requires unused GPIO header pins listed
            in targets/esp32s31/ethernet_rx.c. USB/UART burst RX stays available
            while streaming is stopped. Direct-link IP: 169.254.9.36/16.

    config ESP_SDR_UART_ENABLED
        bool "Burst UART0 I/Q transport" if !IDF_TARGET_ESP32
        depends on IDF_TARGET_ESP32C5 || IDF_TARGET_ESP32C3 || IDF_TARGET_ESP32 || IDF_TARGET_ESP32S2 || IDF_TARGET_ESP32S3 || IDF_TARGET_ESP32C61 || IDF_TARGET_ESP32C6 || IDF_TARGET_ESP32S31
        default y
        help
            Enable the optional USB-to-UART bridge interface. Disable it to
            leave the UART GPIOs unused by the application. Native USB remains
            available on chips that support it. The original ESP32 requires UART.

    config ESP_SDR_UART_BAUD
        int "Burst UART0 I/Q baud rate"
        depends on IDF_TARGET_ESP32C5 || IDF_TARGET_ESP32C3 || IDF_TARGET_ESP32 || IDF_TARGET_ESP32S2 || IDF_TARGET_ESP32S3 || IDF_TARGET_ESP32C61 || IDF_TARGET_ESP32C6 || IDF_TARGET_ESP32S31
        range 115200 3000000
        default 2000000
        help
            The burst I/Q protocol is also available on UART0, 8N1, without
            hardware flow control. The browser baud rate must match this value.
            BAUD 1000000 and BAUD 2000000 can change the running UART rate.
            Resetting the board restores this configured default.

    config ESP_SDR_UART_TX_PIN
        int "Burst UART0 TX GPIO"
        depends on IDF_TARGET_ESP32C5 || IDF_TARGET_ESP32C3 || IDF_TARGET_ESP32 || IDF_TARGET_ESP32S2 || IDF_TARGET_ESP32S3 || IDF_TARGET_ESP32C61 || IDF_TARGET_ESP32C6 || IDF_TARGET_ESP32S31
        range 0 48 if !IDF_TARGET_ESP32S31
        range 0 63 if IDF_TARGET_ESP32S31
        default 1 if IDF_TARGET_ESP32
        default 21 if IDF_TARGET_ESP32C3
        default 58 if IDF_TARGET_ESP32S31
        default 16 if IDF_TARGET_ESP32C6
        default 11 if IDF_TARGET_ESP32C61 || IDF_TARGET_ESP32C5
        default 43

    config ESP_SDR_UART_RX_PIN
        int "Burst UART0 RX GPIO"
        depends on IDF_TARGET_ESP32C5 || IDF_TARGET_ESP32C3 || IDF_TARGET_ESP32 || IDF_TARGET_ESP32S2 || IDF_TARGET_ESP32S3 || IDF_TARGET_ESP32C61 || IDF_TARGET_ESP32C6 || IDF_TARGET_ESP32S31
        range 0 48 if !IDF_TARGET_ESP32S31
        range 0 63 if IDF_TARGET_ESP32S31
        default 3 if IDF_TARGET_ESP32
        default 20 if IDF_TARGET_ESP32C3
        default 59 if IDF_TARGET_ESP32S31
        default 17 if IDF_TARGET_ESP32C6
        default 10 if IDF_TARGET_ESP32C61
        default 12 if IDF_TARGET_ESP32C5
        default 44

endmenu
```

## sdkconfig.defaults.esp32s31_eth
```kconfig
# Apply after sdkconfig.defaults.esp32s31, for Function CoreBoard-1 only.
CONFIG_ESP_SDR_S31_ETHERNET=y
CONFIG_ETH_USE_ESP32_EMAC=y
# CONFIG_ETH_USE_SPI_ETHERNET is not set
CONFIG_ETH_DMA_BUFFER_SIZE=1536
CONFIG_ETH_DMA_RX_BUFFER_NUM=6
CONFIG_ETH_DMA_TX_BUFFER_NUM=8
CONFIG_ETH_TRANSMIT_MUTEX=y
CONFIG_ETH_IRAM_OPTIMIZATION=y
CONFIG_LWIP_TCPIP_CORE_LOCKING=y
CONFIG_LWIP_TCPIP_TASK_AFFINITY_CPU0=y
CONFIG_LWIP_TCPIP_TASK_PRIO=20
CONFIG_ESP_WIFI_STATIC_RX_BUFFER_NUM=2
CONFIG_ESP_WIFI_DYNAMIC_RX_BUFFER_NUM=2
CONFIG_ESP_WIFI_DYNAMIC_TX_BUFFER_NUM=4
# CONFIG_ESP_WIFI_NVS_ENABLED is not set
CONFIG_PARTITION_TABLE_SINGLE_APP_LARGE=y
CONFIG_SPIRAM=y
CONFIG_SPIRAM_MODE_OCT=y
# PSRAM and RGMII share a PLL: 250 MHz permits the 125 MHz RGMII clock.
CONFIG_SPIRAM_SPEED_250M=y
# CONFIG_SPIRAM_SPEED_200M is not set
CONFIG_SPIRAM_USE_MALLOC=y
CONFIG_SPIRAM_MALLOC_ALWAYSINTERNAL=256
CONFIG_SPIRAM_MALLOC_RESERVE_INTERNAL=65536
CONFIG_SPIRAM_TRY_ALLOCATE_WIFI_LWIP=y
CONFIG_SPIRAM_MEMTEST=y
CONFIG_LWIP_TCP_SND_BUF_DEFAULT=114688
CONFIG_LWIP_TCP_WND_DEFAULT=262140
CONFIG_LWIP_TCP_TMR_INTERVAL=100
CONFIG_LWIP_TCP_RTO_TIME=200

CONFIG_LWIP_WND_SCALE=y
CONFIG_LWIP_TCP_RCV_SCALE=2

CONFIG_LWIP_IRAM_OPTIMIZATION=y

CONFIG_LWIP_EXTRA_IRAM_OPTIMIZATION=y
```
